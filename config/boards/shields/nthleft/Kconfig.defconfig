## config/boards/shields/nthleft/Kconfig.defconfig
```kconfig
# Copyright (c) 2021 The ZMK Contributors
# SPDX-License-Identifier: MIT

if SHIELD_NTHLEFT

config ZMK_KEYBOARD_NAME
    default "nthLeft"

endif
```
